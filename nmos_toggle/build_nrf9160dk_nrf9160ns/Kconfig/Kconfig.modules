## nmos_toggle/build_nrf9160dk_nrf9160ns/Kconfig/Kconfig.modules
```kconfig
osource "/home/alejandro/nrf/ncs/nrf/Kconfig.nrf"

osource "/home/alejandro/nrf/ncs/bootloader/mcuboot/zephyr/Kconfig"

osource "/home/alejandro/nrf/ncs/nrfxlib/Kconfig.nrfxlib"
```

## nmos_toggle/build_thingy91_nrf9160ns/Kconfig/Kconfig.soc.arch
```kconfig
osource "/home/alejandro/nrf/ncs/zephyr/soc/$(ARCH)/Kconfig"
osource "/home/alejandro/nrf/ncs/zephyr/soc/$(ARCH)/*/Kconfig"
```

## nmos_toggle/sample.yaml
```yaml
sample:
  description: NMOS Toggle sample, the simplest Zephyr
    application
  name: nmos toggle
common:
    tags: introduction
    integration_platforms:
      - native_posix
    harness: console
    harness_config:
      type: one_line
      regex:
        - "NMOS Toggle (.*)"
tests:
  sample.basic.nmostoggle:
    tags: introduction
```
